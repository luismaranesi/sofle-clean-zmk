/* LEFT: central/master via BLE */
&split {
    compatible = "zmk,split-bluetooth";
    status = "okay";
    role = "central";
};

/* garanta que serial/TRRS fique desligado */
&split_serial {
    status = "disabled";
};

/* habilita o controlador USB do nRF52840 (necessário p/ Studio via USB) */
&usbd {
    status = "okay";
};
