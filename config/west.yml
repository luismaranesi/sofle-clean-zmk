## config/west.yml
```yaml
manifest:
  remotes:
    - name: zmkfirmware
      url-base: https://github.com/zmkfirmware
  projects:
    - name: zmk
      remote: zmkfirmware
      revision: v0.3.0          # você pode piná-lo depois se quiser estabilidade
      import: app/west.yml    # <- caminho correto do manifest do ZMK
  self:
    path: config
```
